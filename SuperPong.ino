//Creator: dusty3692
//Credit to Jonathan Holmes (crait) for the tutorial
//SuperPong

#include <Arduboy2.h>
#include <ArduboyPlaytune.h>
Arduboy2 arduboy;
ArduboyPlaytune tunes(arduboy.audio.enabled);
//Variables declared here
const byte wall[] PROGMEM = {
 0x90,58, 0x91,77, 0,23, 0x80, 0,11, 0x81,
 0xf0
};
const byte point[] PROGMEM = {
 0x90,71, 0,11, 0x80,
 0xf0
};
int justpressedr = 0;
int justpressedl = 0;
const byte paddle[] PROGMEM = {
 0x90,89, 0x91,98, 0,11, 0x92,70, 0,11, 0x80, 0x81, 0x82,
 0xf0
};
const byte good[] PROGMEM = {
 2,43, 0x90,54, 0x91,49, 0,111, 0x92,42, 0x90,54, 0x91,49, 1,77, 0x92,42, 0x90,61, 0x91,66, 1,77, 0x92,42,
 0x90,61, 0x91,58, 1,77, 0x92,42, 0,222, 0x90,58, 0x91,49, 0,111, 0x92,47, 0x90,54, 0x91,59, 1,77, 0x92,47,
 0x90,61, 0x91,54, 1,77, 0x92,47, 0x90,63, 0x91,54, 1,77, 0x92,47, 0,222, 0x90,61, 0x91,56, 0,111, 0x92,49,
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 2,154, 0x80, 0x81, 0x82, 0xf0
};
const byte dead[] PROGMEM = {
 0x90,53, 2,119, 0x90,48, 2,119, 0x90,41, 2,119, 0x90,51, 7,102, 0x90,51, 2,119, 0x90,41, 2,119, 0x90,48,
 2,119, 0x90,53, 7,102, 0x80,
 0xf0
};
// This score contains 34 bytes, and 1 tone generator is used.
const byte game[] PROGMEM = {
 0x90,56, 0,138, 0x90,59, 0,138, 0x91,80, 0x92,75, 0x90,63, 0,138, 0x90,51, 0,133, 0x90,56, 0,138, 0x90,63,
 0,144, 0x90,79, 0x91,75, 0x92,63, 1,21, 0x90,78, 0x91,75, 0x92,56, 0,138, 0x92,59, 0,133, 0x92,63, 0,138,
 0x82, 0,5, 0x92,51, 0,138, 0x90,77, 0x91,75, 0x92,56, 0,133, 0x82, 0,5, 0x92,63, 0,138, 0x90,76, 0x91,70,
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 0x91,67, 0x92,60, 0,138, 0x90,55, 0x91,67, 0x92,60, 0,138, 0x80, 0x81, 0x82,
 0xf0
};
// This score contains 2588 bytes, and 3 tone generators are used.

const byte title[] PROGMEM = {
// Rodland
 0x90,75, 0,120, 0x91,56, 0x92,44, 0x90,80, 0,240, 0x90,80, 0,120, 0x91,72, 0x90,72, 0x93,63, 0x94,68,
 0,240, 0x90,72, 0,120, 0x91,72, 0x90,75, 0x93,68, 0x94,63, 0,240, 0x90,75, 0,120, 0x91,56, 0x92,44, 0x90,68,
 0x83, 0x84, 0,240, 0x90,68, 0,120, 0x91,68, 0x90,72, 0x93,72, 0x94,63, 0,240, 0x90,72, 0,120, 0x91,68, 0x90,63,
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 0x91,56, 0x92,32, 0x90,80, 0x84, 0x85, 1,105, 0x91,72, 0x94,68, 0x95,63, 2,150, 0x80, 0,60, 0x81, 0x82, 0x84, 0x85,
 0xf0
};
// This score contains 865 bytes, and 6 tone generators are used.

const byte difficulty[] PROGMEM = {
 0x80, 0x81, 0,151, 0x90,48, 0,176, 0x80, 0,10, 0x90,52, 0,176, 0x80, 0,10, 0x90,55,
 0,176, 0x80, 0,10, 0x90,59, 0,176, 0x80, 0,10, 0x90,60, 0,176, 0x80, 0,10, 0x90,59, 0,176, 0x80, 0,10,
 0x90,55, 0,176, 0x80, 0,10, 0x90,52, 0,176, 0x80, 0,10, 0x90,48, 0,176, 0x80, 0,10, 0x90,52, 0,176, 0x80,
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 0,176, 0x80, 0,10, 0x90,40, 6,243, 0x80,
 0xf0
};
// This score contains 1853 bytes, and 4 tone generators are used.

const unsigned char lose[] PROGMEM = {
  0x00, 0x00, 0x00, 0x00, 0x00, 0x00, 0x00, 0x00, 0x00, 0x00, 0x00, 0x00,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 0x00, 
};
const unsigned char win[] PROGMEM = {
  0x00, 0x00, 0x00, 0x00, 0x00, 0x00, 0x00, 0x00, 0x00, 0x00, 0x00, 0x00,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 0x00, 
};
const unsigned char logo[] PROGMEM = {
0x00, 0x00, 0x00, 0x00, 0x00, 0x00, 0x00, 0x00, 0x00, 0x00, 0x00, 0x00,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 0x00, 
};
int movechance = 15;
int gamestate = 0;
int death = 0;
int pause = 0;
int justpressed = 0;
int justpressedu = 0;
int justpressedd = 0;
int justpressedb = 0;
int counter = 0;
int ballx = 62;
int bally = 31;
int ballsize = 4;
int origc = 0;
int ballright = -1;
int balldown = 1;
int paddlewidth = 4;
int paddleheight = 9;
int playerx = 0;
int orig = 0;
int sound = 1;
int endless = 0;
int playery = 0;
int computerx = 127 - paddlewidth;
int computery = 0;
int playerscore = 0;
int computerscore = 0;
int menuselect = 1;
void resetgame(){
  ballx = 63;
  bally = 31;
  playerscore = 0;
  computerscore = 0;
}

void setup() {
  arduboy.begin();

  // audio setup
  tunes.initChannel(PIN_SPEAKER_1);
#ifndef AB_DEVKIT
  // if not a DevKit
  tunes.initChannel(PIN_SPEAKER_2);
#else
  // if it's a DevKit
  tunes.initChannel(PIN_SPEAKER_1); // use the same pin for both channels
  tunes.toneMutesScore(true);       // mute the score when a tone is sounding
#endif

  //Seed the random number generator
  arduboy.initRandomSeed();
  //Set the game to 60 frames per second
  arduboy.setFrameRate(60);
  arduboy.clear();
}

void loop() {
  //Prevent the Arduboy from running too fast
  if(!arduboy.nextFrame()) {
    return;
  }
  arduboy.clear();
  //Game code here
  switch( gamestate ) {
    case 0:
      //Title screen
      if(!tunes.playing()){
        tunes.playScore(title);
      }
      arduboy.drawBitmap(0,3,logo,128,64,WHITE);
      counter = counter + 1; //Increase counter variable
      if(counter < 45) {
        arduboy.setCursor(4,55);
        arduboy.print("A = PLAY   B = MENU"); //If the counter is less than 60, show the text
      }
      if(counter >= 90) {
        counter = 0; //If counter is greater than or less than 120, reset it back to 0
      }
       if (arduboy.pressed(B_BUTTON) and justpressedb == 0){
        gamestate = 9;
        justpressedb = 1;
      }
      //Change the gamestate
      
      if(arduboy.pressed(A_BUTTON) and justpressed == 0) {
        tunes.stopScore();
        justpressed = 1;
        gamestate = 1;
      }
      break;
    case 1:
    if(!tunes.playing()){
      tunes.playScore(difficulty);
    }
      //Difficuly set
      if(movechance ==15) {
        arduboy.setCursor(1,27);
        arduboy.print("Difficulty -> EASY");
        arduboy.setCursor(87,35);
        arduboy.print("MEDIUM");
        arduboy.setCursor(87,43);
        arduboy.print("HARD");
      }
      if(movechance == 10) {
        arduboy.setCursor(87,19);
        arduboy.print("EASY");
        arduboy.setCursor(1,27);
        arduboy.print("Difficulty -> MEDIUM");
        arduboy.setCursor(87,35);
        arduboy.print("HARD");
      }
      if(movechance == 5) {
        arduboy.setCursor(87,11);
        arduboy.print("EASY");
        arduboy.setCursor(87,19);
        arduboy.print("MEDIUM");
        arduboy.setCursor(1,27);
        arduboy.print("Difficulty -> HARD");
      }
      if(movechance ==-1) {
        arduboy.setCursor(87,3);
        arduboy.print("EASY");
        arduboy.setCursor(87,11);
        arduboy.print("MEDIUM");
        arduboy.setCursor(87,19);
        arduboy.print("HARD");
        arduboy.setCursor(1,27);
        arduboy.print("Difficulty -> DEVTEST");
      }
      if(arduboy.pressed(LEFT_BUTTON) and arduboy.pressed(RIGHT_BUTTON)) {
        movechance = -1;
      }
      
      if(arduboy.pressed(UP_BUTTON) and justpressedu == 0) {
        justpressedu = 1;
        movechance = movechance + 5;
      }
      if(arduboy.pressed(DOWN_BUTTON)and justpressedd == 0) {
        justpressedd = 1;
        movechance = movechance - 5;
      }
      if( movechance == 20) {
        movechance = 15;
      }
      if (movechance == 0) {
        movechance = 5;
      }
      if (movechance == 4) {
        movechance = 5;
      }
      if (movechance == -6) {
        movechance = -1;
      }
      if (arduboy.pressed(A_BUTTON) and justpressed == 0) {
        gamestate = 16;
        justpressed = 1;
      }
      break;
    case 16:
      if(!tunes.playing()){
       tunes.playScore(difficulty);
      }
      if(endless == 0) {
        arduboy.setCursor(24,27);
        arduboy.print("Endless -> OFF");
        arduboy.setCursor(92,35);
        arduboy.print("ON");
      }
      if(endless == 1) {
        arduboy.setCursor(92,19);
        arduboy.print("OFF");
        arduboy.setCursor(24,27);
        arduboy.print("Endless -> ON");
      }
      if( arduboy.pressed(UP_BUTTON) and justpressedu == 0) {
        justpressedu = 1;
        endless = 0;
      }
      if(arduboy.pressed(DOWN_BUTTON) and justpressedd == 0) {
        justpressedd = 1;
        endless = 1;
      }
      if(arduboy.pressed(A_BUTTON) and justpressed == 0) {
        gamestate = 2;
        justpressed = 1;
        tunes.stopScore();
      }
      break;
    case 54:
    if(!tunes.playing()){
      tunes.playScore(title);
    }
    arduboy.setCursor(0,16);
    arduboy.print("SOUND NEEDS TO BE");
    arduboy.print("\n");
    arduboy.print("ON TO ENABLE");
    arduboy.print("\n");
    arduboy.print("ORIGINAL SFX");
    menuselect = 1;
    counter = counter + 1;
       if(counter < 45) {
        arduboy.setCursor(0,55);
        arduboy.print("press B to go to menu"); //If the counter is less than 60, show the text
      }
      if(counter >= 90) {
        counter = 0; //If counter is greater than or less than 120, reset it back to 0
      }
      if (arduboy.pressed(B_BUTTON)) {
        justpressedb = 1;
        gamestate = 9;
      }
      break;
    case 9:
      //menu
      if(sound == 0) {
        orig = 0;
      }
      if(sound == 0 and menuselect == 2) {
        gamestate = 54;
      }
      counter = counter + 1;
       if(counter < 45) {
        arduboy.setCursor(20,55);
        arduboy.print("press B to exit"); //If the counter is less than 60, show the text
      }
      if(counter >= 90) {
        counter = 0; //If counter is greater than or less than 120, reset it back to 0
      }
      if(!tunes.playing()){
        tunes.playScore(title);
      }
      if(arduboy.pressed(B_BUTTON) and justpressedb == 0) {
        justpressedb = 1;
        gamestate = 0;
      }
      if(arduboy.pressed(DOWN_BUTTON) and justpressedd == 0) {
        justpressedd = 1;
        menuselect = menuselect + 1;
      }
      if(arduboy.pressed(UP_BUTTON) and justpressedu == 0) {
        justpressedu = 1;
        menuselect = menuselect - 1;
      }
      if (menuselect == 0) {
        menuselect = 1;
      }
      if (menuselect == 3) {
        menuselect = 2;
      }
      if(menuselect == 1) {
        if(arduboy.pressed(RIGHT_BUTTON) and justpressedr == 0) {
        justpressedr = 1;
        sound = 0;
      }
      if(arduboy.pressed(LEFT_BUTTON) and justpressedl == 0) {
        justpressedl = 1;
        sound = 1;
      }
        if(sound == 1){
          arduboy.setCursor(10, 10);
          arduboy.print(">SOUND ON>");
        }
        if(sound == 0){
         arduboy.setCursor(10, 10);
         arduboy.print(">SOUND <OFF");
        }
      }
      if(menuselect > 1) {
        if(sound == 1){
          arduboy.setCursor(10, 10);
          arduboy.print("SOUND ON>");
        }
        if(sound == 0){
         arduboy.setCursor(10, 10);
         arduboy.print("SOUND <OFF");
        }
      }
      if(menuselect == 2) {
        if(arduboy.pressed(RIGHT_BUTTON) and justpressedr == 0) {
        justpressedr = 1;
        orig = 0;
      }
      if(arduboy.pressed(LEFT_BUTTON) and justpressedl == 0) {
        justpressedl = 1;
        orig = 1;
      }
      if(orig == 1){
          arduboy.setCursor(10, 20);
          arduboy.print(">ORIGINAL SFX ON>");
        }
        if(orig == 0){
         arduboy.setCursor(10, 20);
         arduboy.print(">ORIGINAL SFX <OFF");
        }
      }
       if(menuselect > 2 or menuselect < 2 ) {
        if(orig == 1){
          arduboy.setCursor(10, 20);
          arduboy.print("ORIGINAL SFX ON>");
        }
        if(orig == 0){
         arduboy.setCursor(10, 20);
         arduboy.print("ORIGINAL SFX <OFF");
        }
       } 
      break;
    case 2:
      if(!tunes.playing() and orig == 0){
        tunes.playScore(game);
      }
      //Gameplay screen
      if(playerscore ==5 and endless == 0) {
        gamestate = 3;
        tunes.stopScore();
      }
      if(computerscore == 5 and endless == 0) {
        gamestate = 4;
        tunes.stopScore();
      }
      arduboy.setCursor(20, 0);
      arduboy.print(playerscore);

      arduboy.setCursor(101,0);
      arduboy.print(computerscore);

      if(ballx < -10) {
        ballx = 63;
        bally =31;
        if (orig == 1){
        tunes.playScore(point);
        }
        ballright = -1;
        computerscore = computerscore + 1;
      }
      if(ballx > 130) {
        ballx = 63;
        bally = 31;
        ballright = -1;
        if (orig == 1) {
        tunes.playScore(point);
        }
        playerscore = playerscore +1;
      }
      //Draw the ball
      arduboy.fillRect(ballx, bally, ballsize, ballsize, WHITE);
      //Move the ball right
      if(ballright == 1) {
        ballx = ballx + 1;
      }
      //Move the ball left
      if(ballright == -1) {
        ballx = ballx - 1;
      }
      //Reflect the ball off of the left side of the screen
      if(ballx == playerx + paddlewidth and playery < bally + ballsize and playery + paddleheight > bally) {
        ballright = 1;
        if(orig == 1) {
        tunes.playScore(paddle);
        }
      }
      //Reflect the ball off of the right side of the screen
      if(ballx + ballsize == computerx and computery < bally + ballsize and computery + paddleheight > bally) {
        ballright = -1;
        if (orig == 1) {
        tunes.playScore(paddle);
        }
      }
      //Move the ball down
      if(balldown == 1) {
        bally = bally + 1;
      }
      //Move the ball up
      if(balldown == -1) {
        bally = bally - 1;
      }
      //Reflect the ball off of the top of the screen
      if(bally == 0) {
        balldown = 1;
        if(orig == 1) {
        tunes.playScore(wall);
        }
      }
      //Reflect the ball off of the bottom of the screen
      if(bally + ballsize == 63) {
        balldown = -1;
        if(orig == 1) {
        tunes.playScore(wall);
        }
      }
      //Draw the player's paddle
      arduboy.fillRect(playerx, playery, paddlewidth, paddleheight, WHITE);
      //If the player presses Up and the paddle is not touching the top of the screen, move the paddle up
      if(arduboy.pressed(UP_BUTTON) and playery > 0) {
        playery = playery - 1;
      }
      //If the player presses down and the paddle is not touching the bottom of the screen, move the paddle down
      if(arduboy.pressed(DOWN_BUTTON) and playery + paddleheight < 63) {
        playery = playery + 1;
      }
      //Draw the computer's paddle
      arduboy.fillRect(computerx, computery, paddlewidth, paddleheight, WHITE);
      //If the ball is close to the edge of the screen or if a random number out of 20 is equal to 1
      if(ballx > 115 or rand() % movechance == 1 or movechance == -1) {
        //If the ball is higher than the computer's paddle, move the computer's paddle up
        if(bally < computery) {
          computery = computery - 1;
        }
        //If the bottom of the ball is lower than the bottom of the computer's paddle, move the comptuer's paddle down
        if(bally + ballsize > computery + paddleheight) {
          computery = computery + 1;
        }
      }



      //If the ball makes contact with the player's paddle, bounce it back to the right
      if(ballx == playerx + paddlewidth and playery < bally + ballsize and playery + paddleheight > bally) {
        ballright = 1;
      }
      //If the ball makes contact with the computer's paddle, bounce it back to the left
      if(ballx + ballsize == computerx and computery < bally + ballsize and computery + paddleheight > bally) {
        ballright = -1;
      }
      //Change the gamestate
      break;
    case 3:
      //Win screen
      if(!tunes.playing()){
        tunes.playScore(good);
      };
      arduboy.drawBitmap(-5,-3,win,128,64,WHITE);
       counter = counter + 1; //Increase counter variable
      if(counter < 30) {
        arduboy.setCursor(80,40);
        arduboy.print("YOU WIN!"); //If the counter is less than 60, show the text
      }
      if(counter >= 60) {
        counter = 0; //If counter is greater than or less than 120, reset it back to 0
      }
      //Change the gamestate
      if(arduboy.pressed(A_BUTTON) and justpressed == 0) {
        resetgame();
        justpressed = 1;
        gamestate = 0;
        tunes.stopScore();
      }
      break;
    case 4:
      //Game over screen
      if(!tunes.playing()){
        tunes.playScore(dead);
      };
      arduboy.drawBitmap(0,0,lose,128,64,WHITE);
      counter = counter + 1; //Increase counter variable
      if(counter < 30) {
        arduboy.setCursor(70,32);
        arduboy.print("GAME OVER"); //If the counter is less than 60, show the text
      }
      if(counter >= 60) {
        counter = 0; //If counter is greater than or less than 120, reset it back to 0
      }
      //Change the gamestate
      if(arduboy.pressed(A_BUTTON) and justpressed == 0) {
        resetgame();
        death = 0;
        justpressed = 1;
        gamestate = 0;
        tunes.stopScore();
      }
        break;
  }
  //Check if the button is being held down
  if(arduboy.notPressed(A_BUTTON)) {
    justpressed = 0;
  }
    //Check if the button is being held down
  if(arduboy.notPressed(UP_BUTTON)) {
    justpressedu = 0;
  }
    //Check if the button is being held down
  if(arduboy.notPressed(DOWN_BUTTON)) {
    justpressedd = 0;
  }
   //Check if the button is being held down
  if(arduboy.notPressed(B_BUTTON)) {
    justpressedb = 0;
  }
  if(arduboy.notPressed(RIGHT_BUTTON)) {
    justpressedr = 0;
  }
  if(arduboy.notPressed(LEFT_BUTTON)) {
    justpressedl = 0;
  }
  if(sound == 0) {
        arduboy.audio.off();
      }
      if(sound == 1) {
        arduboy.audio.on();
      }
  arduboy.display();
}
